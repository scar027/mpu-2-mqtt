## main/Kconfig.projbuild
```kconfig
menu "Broker Configuration"

    config BROKER_URI
        string "Broker URL"
        default "mqtts://test.mosquitto.org:8883"
        help
            URL of an mqtt broker which this example connects to.

    config BROKER_CERTIFICATE_OVERRIDE
        string "Broker certificate override"
        default ""
        help
            Please leave empty if broker certificate included from a textfile; otherwise fill in a base64 part of PEM
            format certificate

    config BROKER_CERTIFICATE_OVERRIDDEN
        bool
        default y if BROKER_CERTIFICATE_OVERRIDE != ""
endmenu

menu "WiFi Configuration"

    config WIFI_SSID
        string "WiFi SSID"
        default "YourSSID"
        help
            The SSID of the WiFi network to connect to.

    config WIFI_PASSWORD
        string "WiFi Password"
        default "YourPassword"
        help
            The password of the WiFi network to connect to.

endmenu
```
